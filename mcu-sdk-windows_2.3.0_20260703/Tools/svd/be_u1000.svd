# BE-U1000 register map
Vendor: BAIKAL ELECTRONICS, JSC; File version: 1.0
Baikal BE-U1000 SVD (System View Description)
CPU: RISC-V r0p0, little endian, no MPU, no FPU, 3 interrupt priority bits
Registers are 32-bit, read-write, reset 0x0 unless marked. A register's access mark holds for its fields unless they carry their own. Offsets are from the block's base; lines under a group give offsets from that group; [hi:lo] are bit positions; {n}, {i} and the like mark numbered series; 'fields as' and 'values as' point back to an identical list; <NAME> marks a mode.

## Memory map
0x11000000 QSPI0 size 0x1000 — Quad Serial Peripheral Interface
0x11000000 CORE2_DEBUG size 0x1000 — CORE2 subsystem, DEBUG
0x11000000 CORE2_TRACE size 0x1000 — CORE2 subsystem, TRACE
0x11001000 UART0 size 0x1000 — Universal Asynchronous Receiver/Transmitter
0x11002000 UART1 size 0x1000
0x11003000 UART2 size 0x1000
0x11004000 I2C0 size 0x1000 — Inter Integrated Circuit Interface
0x11005000 I2C1 size 0x1000
0x11006000 I2S0 size 0x1000 — Inter Integrated Circuit Sound Interface
0x11007000 TIM0 size 0x1000 — Timer
0x11008000 WDT0 size 0x1000 — WatchDog Timer (WDT)
0x11009000 GPIO0 size 0x1000 — General Purpose I/O
0x1100A000 PWMG0 size 0x1000 — General Purpose Timer
0x1100B000 SPI0 size 0x1000 — Serial Peripheral Interface (SPI)
0x1100C000 SPI1 size 0x1000
0x11010000 CANFD0 size 0x1000 — Controller Area Network
0x13000000 QSPI1 size 0x1000
0x13001000 UART3 size 0x1000
0x13002000 UART4 size 0x1000
0x13003000 UART5 size 0x1000
0x13004000 I2C2 size 0x1000
0x13005000 I2C3 size 0x1000
0x13006000 I2S1 size 0x1000
0x13007000 TIM1 size 0x1000
0x13008000 WDT1 size 0x1000
0x13009000 GPIO1 size 0x1000
0x1300A000 PWMG1 size 0x1000
0x1300B000 SPI2 size 0x1000
0x1300C000 SPI3 size 0x1000
0x13010000 CANFD1 size 0x1000
0x14000000 CRU size 0x1000 — Control Registers Unit
0x14001000 ADC0 size 0x1000 — Analog to Digital Converter
0x14002000 ADC1 size 0x1000
0x14003000 ADC2 size 0x1000
0x14004000 PWMA0 size 0x1000 — Advanced-control Timer
0x14004050 QE0 size 0x1000 — Quadrature Encoder
0x14005000 PWMA1 size 0x1000
0x14005050 QE1 size 0x1000
0x14006000 PWMA2 size 0x1000
0x14006050 QE2 size 0x1000
0x14007000 PWMA3 size 0x1000
0x14007050 QE3 size 0x1000
0x14008000 GPIO2 size 0x1000
0x14009000 UART6 size 0x1000
0x1400A000 UART7 size 0x1000
0x1400B000 AXI size 0x1000 — Advanced eXtensible Interface
0x15000000 USB size 0x1000
0x15100000 DMA0 size 0x1000 — Direct Memory Access Controller
0x15101000 DMA1 size 0x1000
0x15103000 MB size 0x1000 — Mailbox
0x15103020 MB1 size 0x1000
0x151037F0 CORE2_INT size 0x1000 — CORE2 subsystem, INT
0x151037F4 CORE2_PIO size 0x1000 — CORE2 subsystem, PIO
0x15108000 AHB size 0x1000 — Advanced High-performance Bus
0xA1000000 EFLASH size 0x1000 — Embedded Flash

## Interrupts
16 CLIC_QSPI0_IRQn (QSPI0)
17 CLIC_UART0_IRQn (UART0)
18 CLIC_UART1_IRQn (UART1)
19 CLIC_UART2_IRQn (UART2)
20 CLIC_I2C0_IRQn (I2C0)
21 CLIC_I2C1_IRQn (I2C1)
22 CLIC_I2S0_IRQn (I2S0)
23 CLIC_TIM0_Channel0_IRQn (TIM0)
24 CLIC_TIM0_Channel1_IRQn (TIM0)
25 CLIC_TIM0_Channel2_IRQn (TIM0)
26 CLIC_TIM0_Channel3_IRQn (TIM0)
27 CLIC_WDT0_IRQn (WDT0)
28 CLIC_GPIO0_IRQn (GPIO0)
29 CLIC_PWMG0_IRQn (PWMG0)
30 CLIC_SPI0_IRQn (SPI0)
31 CLIC_SPI1_IRQn (SPI1)
32 CLIC_CANFD0_IRQn (CANFD0)
33 CLIC_QSPI1_IRQn (QSPI1)
34 CLIC_UART3_IRQn (UART3)
35 CLIC_UART4_IRQn (UART4)
36 CLIC_UART5_IRQn (UART5)
37 CLIC_I2C2_IRQn (I2C2)
38 CLIC_I2C3_IRQn (I2C3)
39 CLIC_I2S1_IRQn (I2S1)
40 CLIC_TIM1_Channel0_IRQn (TIM1)
41 CLIC_TIM1_Channel1_IRQn (TIM1)
42 CLIC_TIM1_Channel2_IRQn (TIM1)
43 CLIC_TIM1_Channel3_IRQn (TIM1)
45 CLIC_GPIO1_IRQn (GPIO1)
46 CLIC_PWMG1_IRQn (PWMG1)
47 CLIC_SPI2_IRQn (SPI2)
48 CLIC_SPI3_IRQn (SPI3)
49 CLIC_CANFD1_IRQn (CANFD1)
50 CLIC_ADC0_IRQn (ADC0)
51 CLIC_ADC1_IRQn (ADC1)
52 CLIC_ADC2_IRQn (ADC2)
53 CLIC_PWMA0_IRQn (PWMA0)
54 CLIC_QE0_IRQn (QE0)
55 CLIC_PWMA1_IRQn (PWMA1)
56 CLIC_QE1_IRQn (QE1)
57 CLIC_PWMA2_IRQn (PWMA2)
58 CLIC_QE2_IRQn (QE2)
59 CLIC_PWMA3_IRQn (PWMA3)
60 CLIC_QE3_IRQn (QE3)
61 CLIC_GPIO2_IRQn (GPIO2)
62 CLIC_UART6_IRQn (UART6)
63 CLIC_UART7_IRQn (UART7)
64 CLIC_USB_IRQn (USB)
65 CLIC_DMA0_IRQn (DMA0)
66 CLIC_DMA1_IRQn (DMA1)
67 CLIC_USB_DMA_IRQn (USB)
68 CLIC_CORE2_IRQn (CORE2_INT)
69 CLIC_CORE2_MB0_IRQn (CORE2_INT)
70 CLIC_CORE2_MB1_IRQn (CORE2_INT)
